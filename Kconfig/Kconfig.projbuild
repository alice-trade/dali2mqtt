## Kconfig/Kconfig.projbuild
```kconfig
menu "DALI MQTT Bridge Settings"
    config DALI2MQTT_PRECONFIGURED
                bool "Enable Headless / Pre-configured Deployment"
                default n
                help
                    If enabled, CMake will verify that all required parameters
                    (Broker URI, Wi-Fi/Eth settings) are populated in Kconfig/sdkconfig.
                    If valid, the firmware will compile in 'configured' state and skip
                    provisioning mode entirely on boot.
    menu "Network Interface Selection"

        choice DALI2MQTT_NETWORK_TYPE
            prompt "Network Interface"
            default DALI2MQTT_NET_WIFI
            help
                Select physical network transport for MQTT and WebUI.

            config DALI2MQTT_NET_WIFI
                bool "Wi-Fi (STA / Provisioning AP)"

            config DALI2MQTT_NET_ETHERNET
                bool "Ethernet (LAN8720 / W5500)"
        endchoice

        menu "Wi-Fi Station (Client) Configuration"
            depends on DALI2MQTT_NET_WIFI && DALI2MQTT_PRECONFIGURED

            config DALI2MQTT_WIFI_STA_SSID
                string "Wi-Fi Station SSID"
                default ""
                help
                    Target Wi-Fi Network SSID to connect on boot.

            config DALI2MQTT_WIFI_STA_PASS
                string "Wi-Fi Station Password"
                default ""
                help
                    Target Wi-Fi Network Password.
        endmenu

        menu "Ethernet Hardware Configuration"
            depends on DALI2MQTT_NET_ETHERNET

            choice DALI2MQTT_ETH_PHY_TYPE
                prompt "Ethernet Controller / PHY"
                default DALI2MQTT_ETH_TYPE_SPI_W5500
                help
                    Choose your Ethernet PHY. For ESP32-S3/C3/C6 use SPI (W5500).

                config DALI2MQTT_ETH_TYPE_SPI_W5500
                    bool "W5500 (SPI) - Recommended for S3/C3/C6/Classic"

                config DALI2MQTT_ETH_TYPE_INTERNAL_RMII
                    bool "Internal EMAC (RMII: LAN8720 / IP101) - ESP32 Classic Only"
                    depends on IDF_TARGET_ESP32
            endchoice

            menu "SPI Ethernet Pins"
                depends on DALI2MQTT_ETH_TYPE_SPI_W5500

                config DALI2MQTT_ETH_SPI_HOST
                    int "SPI Host ID (1=SPI2_HOST)"
                    default 1
                    range 1 2

                config DALI2MQTT_ETH_SPI_SCK_PIN
                    int "SPI SCK GPIO"
                    default 12

                config DALI2MQTT_ETH_SPI_MOSI_PIN
                    int "SPI MOSI GPIO"
                    default 11

                config DALI2MQTT_ETH_SPI_MISO_PIN
                    int "SPI MISO GPIO"
                    default 13

                config DALI2MQTT_ETH_SPI_CS_PIN
                    int "SPI CS GPIO"
                    default 10

                config DALI2MQTT_ETH_SPI_INT_PIN
                    int "Interrupt (INT) GPIO"
                    default 9

                config DALI2MQTT_ETH_SPI_RST_PIN
                    int "Reset (RST) GPIO (-1 if unused)"
                    default 14

                config DALI2MQTT_ETH_SPI_CLOCK_MHZ
                    int "SPI Clock Speed (MHz)"
                    default 25
                    range 10 33
            endmenu

        endmenu

    endmenu
    
    menu "DALI Configuration"
    comment "Protocol Configuration"

    config DALI2MQTT_DALI_RX_PIN
        int "DALI (Driver 0) RX GPIO Pin"
        default 16
        range 0 39
        help
            GPIO pin number for first driver used for receiving DALI signals.

    config DALI2MQTT_DALI_TX_PIN
        int "DALI (Driver 0) TX GPIO Pin"
        default 17
        range 0 39
        help
            GPIO pin number for first driver used for transmitting DALI signals.

    config DALI2MQTT_DALI_DEFAULT_POLL_INTERVAL_MS
        int "Default DALI Sync Poll Interval (ms)"
        default 300000
        range 30000 3600000
        help
            Default interval for syncronizing (polling) DALI status for all devices

    config DALI2MQTT_DALI_TRANSACTION_TIMEOUT_MS
        int "DALI Transaction Timeout (ms)"
        default 100
        range 50 1000
        help
            Timeout in milliseconds for waiting for a DALI backward frame.

    config DALI2MQTT_DALI_INTER_FRAME_DELAY_MS
        int "DALI Inter-Frame Delay (ms)"
        default 20
        range 10 100
        help
            Minimum delay between DALI forward frames.

    config DALI2MQTT_DALI_POLL_DELAY_MS
        int "DALI Poll Delay (ms)"
        default 15
        range 10 200
        help
            Delay between polling different DALI addresses within one poll cycle.

    comment "Debug Options"

    config DALI2MQTT_SNIFFER_DEBUG_PUBLISH_MQTT
                        bool "Enable Sniffer debug messages publish to MQTT"
                        default n
                        help
                             Enable sending raw DALI frames captured by the sniffer to MQTT.
                                        Topic: <mqtt_base>/debug/sniffer_raw

                                        Payload Schema (JSON):
                                        {
                                            "type": "forward" | "backward",  // Frame direction
                                            "len":  <int>,                   // Bit length (8, 16, 24)
                                            "data": <uint32>,                // Raw integer value
                                            "hex":  "<HEX_STRING>",          // Hexadecimal representation
                                            "ts":   <uint32>                 // ESP log timestamp (ms)
                                        }


    comment "Task Configuration"

    config DALI2MQTT_DALI_POLL_TASK_STACK_SIZE
            int "DALI Poll Task Stack Size"
            default 4096
            range 4096 16384
            help
                Stack size for the DALI polling task.

        config DALI2MQTT_DALI_POLL_TASK_PRIORITY
            int "DALI Poll Task Priority"
            default 5
            range 1 24 # tskIDLE_PRIORITY + 1 to configMAX_PRIORITIES - 1
            help
                Priority of the DALI polling task.

    endmenu

    menu "MQTT Client Configuration"

    config DALI2MQTT_MQTT_BROKER_URI
        string "MQTT Broker URI"
        depends on DALI2MQTT_PRECONFIGURED
        default ""
        help
            Target broker URI (e.g. "mqtt://192.168.1.10:1883" or "mqtts://host:8883").

    config DALI2MQTT_MQTT_USER
        string "MQTT Username"
        depends on DALI2MQTT_PRECONFIGURED
        default ""

    config DALI2MQTT_MQTT_PASS
        string "MQTT Password"
        depends on DALI2MQTT_PRECONFIGURED
        default ""

    config DALI2MQTT_MQTT_HOMEASSISTANT_DISCOVERY_ENABLED
        bool "Enable Home Assistant MQTT Auto-Discovery by default"
        default y
        help
                Automatically publish MQTT discovery configuration topics for Home Assistant
                on startup. Can still be toggled later in WebUI.

    config DALI2MQTT_MQTT_BASE_TOPIC
        string "MQTT Base Topic"
        default "dali_bridge"
        help
            Base topic used for publishing status and subscribing to commands.

    config DALI2MQTT_MQTT_AVAILABILITY_TOPIC
        string "MQTT Availability Topic"
        default "/status"
        help
            Sub-topic for availability status (appended to Base Topic).

    config DALI2MQTT_MQTT_LIGHT_CMD_SUBTOPIC
        string "MQTT Light Command Sub-Topic"
        default "/light/+/+/set"
        help
            Sub-topic pattern for light commands (appended to Base Topic).

    config DALI2MQTT_MQTT_LIGHT_STATE_SUBTOPIC
        string "MQTT Light State Sub-Topic Prefix"
        default "/light"
        help
            Sub-topic prefix for light states (e.g., /light/group/0/state).

    config DALI2MQTT_MQTT_SCENE_CMD_SUBTOPIC
        string "MQTT Scene Command Sub-Topic"
        default "/scene/set"
        help
            Sub-topic for activating DALI scenes (appended to Base Topic).

    config DALI2MQTT_MQTT_CONFIG_SET_SUBTOPIC
        string "MQTT Config Set Sub-Topic"
        default "/config/set"
        help
            Sub-topic for setting configuration (appended to Base Topic).

    config DALI2MQTT_MQTT_CONFIG_GET_SUBTOPIC
        string "MQTT Config Get Sub-Topic"
        default "/config/get"
        help
            Sub-topic for requesting configuration (appended to Base Topic).

    config DALI2MQTT_MQTT_CONFIG_RESP_SUBTOPIC
        string "MQTT Config Response Sub-Topic"
        default "/config/get/response"
        help
            Sub-topic for publishing configuration response (appended to Base Topic).

    config DALI2MQTT_MQTT_GROUP_SET_SUBTOPIC
        string "MQTT Group Management Set Sub-Topic"
        default "/config/group/set"
        help
            Sub-topic for setting group membership (appended to Base Topic).

    config DALI2MQTT_MQTT_GROUP_RES_SUBTOPIC
        string "MQTT Group Management Result Sub-Topic"
        default "/config/group/result"
        help
            Sub-topic for group management result (appended to Base Topic).

    config DALI2MQTT_MQTT_PAYLOAD_ONLINE
        string "MQTT Payload Online"
        default "online"
        help
            Payload for online availability status.

    config DALI2MQTT_MQTT_PAYLOAD_OFFLINE
        string "MQTT Payload Offline"
        default "offline"
        help
            Payload for offline availability status (LWT).
    endmenu

    menu "WiFi AP Credentials"

    config DALI2MQTT_WIFI_AP_SSID
        string "WiFi AP SSID"
        default "DALI-MQTT-Bridge"
        help
            Default WiFi AP network name (SSID).

    config DALI2MQTT_WIFI_AP_PASS
        string "WiFi AP Password"
        default "bridge123"
        help
            Default WiFi AP network password.

    config DALI2MQTT_WIFI_MAX_RETRY
        int "WiFi Maximum Connection Retries"
        default 10
        range 5 30
        help
            Number of times to retry connecting to WiFi before failing and entering deep sleep.
            The counter is stored in NVS and persists across reboots. It is reset upon successful connection.

    config DALI2MQTT_WIFI_DEEP_SLEEP_S
        int "Deep Sleep Duration (seconds)"
        default 300
        help
            Duration in seconds to stay in deep sleep after exceeding WiFi connection retries.

    endmenu

    menu "NVS Configuration"

    config DALI2MQTT_NVS_NAMESPACE
        string "NVS Namespace"
        default "dali_cfg"
        help
            Namespace used for storing configuration in NVS.
    endmenu

    menu "Web UI Configuration"

        config DALI2MQTT_WEBUI_SPIFFS_PARTITION_LABEL
            string "LittleFS Partition Label"
            default "web_storage"
            help
                Label of the LittleFS partition where the Web UI files are stored.

        config DALI2MQTT_WEBUI_DEFAULT_USER
            string "Default Web UI Username"
            default "admin"
            help
                Default username for Web UI HTTP Basic Authentication. Used if not in NVS.

        config DALI2MQTT_WEBUI_DEFAULT_MDNS_DOMAIN
            string "Default Web UI mDNS Domain Prefix"
            default "dalimqtt"
            help
                Default domain prefix for Web UI mDNS hostname. Will be published as <addr>.local

        config DALI2MQTT_WEBUI_DEFAULT_PASS
            string "Default Web UI Password"
            default "admin"
            help
                Default password for Web UI HTTP Basic Authentication. Used if not in NVS.
        endmenu

        menu "Syslog Configuration"

            config DALI2MQTT_SYSLOG_ENABLED_BY_DEFAULT
                    bool "Enable Syslog logging by default"
                    default n
                    help
                        Enable sending ESP-IDF logs to a remote syslog server by default on first boot.
                        This can be changed later in the WebUI.


            config DALI2MQTT_SYSLOG_DEFAULT_SERVER
                    string "Default Syslog Server IP Address"
                    depends on DALI2MQTT_SYSLOG_ENABLED_BY_DEFAULT
                    default ""
                    help
                        The default IP address or hostname of the syslog server.
                        This can be overridden in the WebUI.

        endmenu
endmenu
```

## support/esp32c3/Release/sdkconfig.defaults
```kconfig
#
# Partition Table
#
CONFIG_PARTITION_TABLE_CUSTOM=y
CONFIG_PARTITION_TABLE_CUSTOM_FILENAME="support/esp32c3/partitions.csv"
CONFIG_PARTITION_TABLE_FILENAME="support/esp32c3/partitions.csv"
CONFIG_PARTITION_TABLE_OFFSET=0x8000
CONFIG_PARTITION_TABLE_MD5=y
# end of Partition Table

#
# Serial flasher config
#

CONFIG_ESPTOOLPY_FLASHMODE_DIO=y
# CONFIG_ESPTOOLPY_FLASHMODE_DOUT is not set
CONFIG_ESPTOOLPY_FLASH_SAMPLE_MODE_STR=y
CONFIG_ESPTOOLPY_FLASHMODE="dio"
CONFIG_ESPTOOLPY_FLASHSIZE_4MB=y
CONFIG_ESPTOOLPY_FLASHSIZE="4MB"
CONFIG_ESPTOOLPY_BEFORE_RESET=y
CONFIG_ESPTOOLPY_BEFORE="default_reset"
CONFIG_ESPTOOLPY_AFTER_RESET=y
CONFIG_ESPTOOLPY_AFTER="hard_reset"
CONFIG_ESPTOOLPY_MONITOR_BAUD=115200
# end of Serial flasher config

#
# DALI MQTT Bridge Settings
#

#
# Web UI Configuration
#
CONFIG_DALI2MQTT_WEBUI_SPIFFS_PARTITION_LABEL="web_storage"
CONFIG_DALI2MQTT_WEBUI_DEFAULT_USER="admin"
CONFIG_DALI2MQTT_WEBUI_DEFAULT_PASS="dalimqttbrg12321"
# end of Web UI Configuration
# end of DALI MQTT Bridge Settings


CONFIG_ESP_SYSTEM_EVENT_QUEUE_SIZE=32
CONFIG_ESP_SYSTEM_EVENT_TASK_STACK_SIZE=4096
CONFIG_ESP_MAIN_TASK_STACK_SIZE=4096

#
# Log Level
#
# CONFIG_LOG_DEFAULT_LEVEL_NONE is not set
# CONFIG_LOG_DEFAULT_LEVEL_ERROR is not set
CONFIG_LOG_DEFAULT_LEVEL_WARN=y
# CONFIG_LOG_DEFAULT_LEVEL_INFO is not set
# CONFIG_LOG_DEFAULT_LEVEL_VERBOSE is not set
CONFIG_LOG_DEFAULT_LEVEL=2
CONFIG_LOG_MAXIMUM_EQUALS_DEFAULT=y
# CONFIG_LOG_MAXIMUM_LEVEL_VERBOSE is not set
CONFIG_LOG_MAXIMUM_LEVEL=2

#
# Compiler options
#
# CONFIG_COMPILER_OPTIMIZATION_DEBUG is not set
# CONFIG_COMPILER_OPTIMIZATION_SIZE is not set
CONFIG_COMPILER_OPTIMIZATION_PERF=y
# CONFIG_COMPILER_OPTIMIZATION_NONE is not set
# CONFIG_COMPILER_OPTIMIZATION_ASSERTIONS_ENABLE is not set
# CONFIG_COMPILER_OPTIMIZATION_ASSERTIONS_SILENT is not set
CONFIG_COMPILER_OPTIMIZATION_ASSERTIONS_DISABLE=y
CONFIG_COMPILER_ASSERT_NDEBUG_EVALUATE=y
CONFIG_COMPILER_FLOAT_LIB_FROM_GCCLIB=y
CONFIG_COMPILER_OPTIMIZATION_ASSERTION_LEVEL=0
# CONFIG_COMPILER_OPTIMIZATION_CHECKS_SILENT is not set
CONFIG_COMPILER_HIDE_PATHS_MACROS=y
# CONFIG_COMPILER_CXX_EXCEPTIONS is not set
# CONFIG_COMPILER_CXX_RTTI is not set
CONFIG_COMPILER_STACK_CHECK_MODE_NONE=y
# CONFIG_COMPILER_STACK_CHECK_MODE_NORM is not set
# CONFIG_COMPILER_STACK_CHECK_MODE_STRONG is not set
# CONFIG_COMPILER_STACK_CHECK_MODE_ALL is not set
# CONFIG_COMPILER_WARN_WRITE_STRINGS is not set
CONFIG_COMPILER_DISABLE_DEFAULT_ERRORS=y
# CONFIG_COMPILER_DISABLE_GCC12_WARNINGS is not set
# CONFIG_COMPILER_DISABLE_GCC13_WARNINGS is not set
# CONFIG_COMPILER_DISABLE_GCC14_WARNINGS is not set
# CONFIG_COMPILER_DUMP_RTL_FILES is not set
CONFIG_COMPILER_RT_LIB_GCCLIB=y
CONFIG_COMPILER_RT_LIB_NAME="gcc"
CONFIG_COMPILER_ORPHAN_SECTIONS_WARNING=y
# CONFIG_COMPILER_ORPHAN_SECTIONS_PLACE is not set

CONFIG_BOOTLOADER_OFFSET_IN_FLASH=0x0
# CONFIG_BOOTLOADER_COMPILER_OPTIMIZATION_SIZE is not set
# CONFIG_BOOTLOADER_COMPILER_OPTIMIZATION_DEBUG is not set
CONFIG_BOOTLOADER_COMPILER_OPTIMIZATION_PERF=y
# CONFIG_BOOTLOADER_COMPILER_OPTIMIZATION_NONE is not set

# end of Compiler options
CONFIG_BOOTLOADER_APP_ROLLBACK_ENABLE=y
CONFIG_FREERTOS_HZ=1000
```
