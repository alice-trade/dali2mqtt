## esp32/Kconfig/Kconfig.projbuild
```kconfig
menu "DALI MQTT Bridge Settings"

    # --- Настройки DALI ---
    menu "DALI Interface Configuration"

    config DALI2MQTT_DALI_RX_PIN
        int "DALI RX GPIO Pin"
        default 16
        range 0 39
        help
            GPIO pin number used for receiving DALI signals.

    config DALI2MQTT_DALI_TX_PIN
        int "DALI TX GPIO Pin"
        default 17
        range 0 39
        help
            GPIO pin number used for transmitting DALI signals.

    config DALI2MQTT_DALI_DEFAULT_POLL_INTERVAL_MS
        int "Default DALI Poll Interval (ms)"
        default 5000
        range 100 3600000
        help
            Default interval for polling DALI status if not found in NVS.

    config DALI2MQTT_DALI_TRANSACTION_TIMEOUT_MS
        int "DALI Transaction Timeout (ms)"
        default 100
        range 50 1000
        help
            Timeout in milliseconds for waiting for a DALI backward frame.

    config DALI2MQTT_DALI_INTER_FRAME_DELAY_MS
        int "DALI Inter-Frame Delay (ms)"
        default 20
        range 10 100
        help
            Minimum delay between DALI forward frames.

    config DALI2MQTT_DALI_POLL_DELAY_MS
        int "DALI Poll Delay (ms)"
        default 50
        range 10 200
        help
            Delay between polling different DALI addresses within one poll cycle.
     # --- Настройки Задач ---
    comment "Task Configuration"

    config DALI2MQTT_DALI_POLL_TASK_STACK_SIZE
            int "DALI Poll Task Stack Size"
            default 4096
            range 4096 16384
            help
                Stack size for the DALI polling task.

        config DALI2MQTT_DALI_POLL_TASK_PRIORITY
            int "DALI Poll Task Priority"
            default 5
            range 1 24 # tskIDLE_PRIORITY + 1 to configMAX_PRIORITIES - 1
            help
                Priority of the DALI polling task.

    endmenu

    # --- Настройки MQTT ---
    menu "MQTT Client Configuration"

    config DALI2MQTT_MQTT_BASE_TOPIC
        string "MQTT Base Topic"
        default "dali_bridge"
        help
            Base topic used for publishing status and subscribing to commands.

    config DALI2MQTT_MQTT_AVAILABILITY_TOPIC
        string "MQTT Availability Topic"
        default "/status"
        help
            Sub-topic for availability status (appended to Base Topic).

    config DALI2MQTT_MQTT_LIGHT_CMD_SUBTOPIC
        string "MQTT Light Command Sub-Topic"
        default "/light/+/+/set"
        help
            Sub-topic pattern for light commands (appended to Base Topic).

    config DALI2MQTT_MQTT_LIGHT_STATE_SUBTOPIC
        string "MQTT Light State Sub-Topic Prefix"
        default "/light"
        help
            Sub-topic prefix for light states (e.g., /light/group/0/state).

    config DALI2MQTT_MQTT_CONFIG_SET_SUBTOPIC
        string "MQTT Config Set Sub-Topic"
        default "/config/set"
        help
            Sub-topic for setting configuration (appended to Base Topic).

    config DALI2MQTT_MQTT_CONFIG_GET_SUBTOPIC
        string "MQTT Config Get Sub-Topic"
        default "/config/get"
        help
            Sub-topic for requesting configuration (appended to Base Topic).

    config DALI2MQTT_MQTT_CONFIG_RESP_SUBTOPIC
        string "MQTT Config Response Sub-Topic"
        default "/config/get/response"
        help
            Sub-topic for publishing configuration response (appended to Base Topic).

    config DALI2MQTT_MQTT_GROUP_SET_SUBTOPIC
        string "MQTT Group Management Set Sub-Topic"
        default "/config/group/set"
        help
            Sub-topic for setting group membership (appended to Base Topic).

    config DALI2MQTT_MQTT_GROUP_RES_SUBTOPIC
        string "MQTT Group Management Result Sub-Topic"
        default "/config/group/result"
        help
            Sub-topic for group management result (appended to Base Topic).

    config DALI2MQTT_MQTT_PAYLOAD_ONLINE
        string "MQTT Payload Online"
        default "online"
        help
            Payload for online availability status.

    config DALI2MQTT_MQTT_PAYLOAD_OFFLINE
        string "MQTT Payload Offline"
        default "offline"
        help
            Payload for offline availability status (LWT).
    endmenu

    # --- Настройки WiFi по умолчанию ---
    menu "WiFi AP Credentials"

    config DALI2MQTT_WIFI_AP_SSID
        string "WiFi AP SSID"
        default "DALI-MQTT-Bridge"
        help
            Default WiFi AP network name (SSID).

    config DALI2MQTT_WIFI_AP_PASS
        string "WiFi AP Password"
        default "bridge123"
        help
            Default WiFi AP network password.

    config DALI2MQTT_WIFI_MAX_RETRY
        int "WiFi Maximum Connection Retries"
        default 5
        range 0 20
        help
            Number of times to retry connecting to WiFi before failing.

    endmenu

    # --- Настройки NVS ---
    menu "NVS Configuration" # Используем comment для заголовка раздела

    config DALI2MQTT_NVS_NAMESPACE
        string "NVS Namespace"
        default "dali_cfg"
        help
            Namespace used for storing configuration in NVS.
    endmenu

     menu "Web UI Configuration"

        config DALI2MQTT_WEBUI_SPIFFS_PARTITION_LABEL
            string "SPIFFS Partition Label"
            default "web_storage"
            help
                Label of the SPIFFS partition where the Web UI files are stored.

        config DALI2MQTT_WEBUI_DEFAULT_USER
            string "Default Web UI Username"
            default "admin"
            help
                Default username for Web UI HTTP Basic Authentication. Used if not in NVS.

        config DALI2MQTT_WEBUI_DEFAULT_PASS
            string "Default Web UI Password"
            default "admin"
            help
                Default password for Web UI HTTP Basic Authentication. Used if not in NVS.
        endmenu
endmenu
```
